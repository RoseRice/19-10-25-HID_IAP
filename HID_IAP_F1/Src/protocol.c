#include "protocol.h"
#include "usbd_custom_hid_if.h"
#include "iap.h"
#include "gpio.h"

static uint32_t FileSize = 0; // 传输的文件大小
static uint16_t BlkIndex = 0; // 数据块序号
static uint16_t BlkSize = 0; // 块有效数据长度
static uint8_t  BlkBuf[BLK_RCV_BUF_SIZE] = {0}; // 接受数据块缓存
static uint16_t BlkOffset = 0; // 块接收数据末尾位置
static uint32_t FileOffset = 0; // 已接收数据大小

static uint16_t CRC16(uint8_t *buf, uint32_t size);

/*
** 功能：准备开始数据传输
** 输入：
** 输出：
*/
uint8_t FunTransReady(void)
{
  uint8_t err_code = 0;
  uint32_t err_inf = 0;
  FLASH_EraseInitTypeDef erase_init;
  
  BlkOffset = 0;
  FileOffset = 0;

  FileSize = RcvUSB.buf[1] + (RcvUSB.buf[2]<<8) + (RcvUSB.buf[3]<<16) + (RcvUSB.buf[4]<<24);

  HAL_FLASH_Unlock(); // 解锁
  // 清空APP Flash空间
  erase_init.TypeErase = FLASH_TYPEERASE_PAGES;
  //erase_init.Banks = FLASH_BANK_1;
  erase_init.PageAddress = FLASH_APP_ADDR;
  erase_init.NbPages = (512-64)/2;

  if(HAL_OK != HAL_FLASHEx_Erase(&erase_init, &err_inf))  err_code = 1;
  HAL_FLASH_Lock(); // 上锁

  // 设备状态应答
  memset(SndUSB.buf, 0x00, sizeof(SndUSB.buf));
  
  SndUSB.hasData = TRUE_t;
  SndUSB.buf[0] = RcvUSB.buf[0];
  SndUSB.buf[1] = err_code;
  SndUSB.buf[2] = err_inf & 0xFF;
  SndUSB.buf[3] = (err_inf>>8) & 0xFF;
  SndUSB.buf[4] = (err_inf>>16) & 0xFF;
  SndUSB.buf[5] = (err_inf>>24) & 0xFF;
  
  return 0;
}

/*
** 功能：数据传输完成
** 输入：
** 输出：
*/
uint8_t FunTransEnd(void)
{
  uint8_t err_code = 0;
  
  if(1 == RcvUSB.buf[1]) // 启动APP程序
  {
    if(((*(vu32 *)(FLASH_APP_ADDR+4))&0xFF000000)==0x08000000)//判断是否为0X08XXXXXX.
    {	 
      err_code = iapLoadAppCheck(FLASH_APP_ADDR);// 检查FLASH APP代码
    }
    else
    {
      err_code = 2;
    }
  }

  // 设备状态应答
  memset(SndUSB.buf, 0x00, sizeof(SndUSB.buf));
  
  SndUSB.hasData = TRUE_t;
  SndUSB.buf[0] = RcvUSB.buf[0];
  SndUSB.buf[1] = err_code;
  USBD_CUSTOM_HID_SendReport(&hUsbDeviceFS, SndUSB.buf, sizeof(SndUSB.buf));
  
  //执行FLASH APP代码
  if(APP_IS_OK == err_code)
  {
    USB_DE_OFF; // 断开USB上拉电阻
    iapLoadApp(FLASH_APP_ADDR);
  }

  return 0;
}

/*
** 功能：启动数据块传输
** 输入：
** 输出：
*/
uint8_t FunBlockStart(void)
{
  BlkOffset = 0;
  
  BlkIndex = RcvUSB.buf[1] + (RcvUSB.buf[2]<<8);
  BlkSize = RcvUSB.buf[3] + (RcvUSB.buf[4]<<8);
  
  // 清空接受缓存
  memset(BlkBuf, 0x00, sizeof(BlkBuf));
  
  // 设备状态应答
  memset(SndUSB.buf, 0x00, sizeof(SndUSB.buf));
  
  SndUSB.hasData = TRUE_t;
  SndUSB.buf[0] = RcvUSB.buf[0];
  SndUSB.buf[1] = 0x00;
  
  return 0;
}

/*
** 功能：数据块传输结束
** 输入：
** 输出：
*/
uint8_t FunBlockFinish(void)
{
  uint8_t err_code = 0;
  
  // 校验后向flash写入数据块
  if((RcvUSB.buf[1]+(RcvUSB.buf[2]<<8)) == CRC16(BlkBuf, BlkOffset))
  {
    if(BlkOffset <= BlkSize)
    {
      if(FileOffset <= FileSize)
      {
        err_code = iapWriteAppBin(FLASH_APP_ADDR+FileOffset, BlkBuf, BlkOffset);
      }
      else
      {
        err_code = 4;
      }
      FileOffset += BlkOffset;
    }
    else
    {
      err_code = 5;
    }
  }
  else
  {
    err_code = 6;
  }
  
  // inote 可考虑回读flash并校验
  
  // 设备状态应答
  memset(SndUSB.buf, 0x00, sizeof(SndUSB.buf));
  
  SndUSB.hasData = TRUE_t;
  SndUSB.buf[0] = RcvUSB.buf[0];
  SndUSB.buf[1] = BlkIndex & 0xFF;
  SndUSB.buf[2] = (BlkIndex>>8) & 0xFF;
  SndUSB.buf[3] = err_code; // 错误码
  
  return 0;
}

/*
** 功能：数据帧传输
** 输入：
** 输出：
*/
uint8_t FunFrameData(void)
{
  if((USBD_CUSTOMHID_OUTREPORT_BUF_SIZE-2) >= RcvUSB.buf[1])
  {
    memcpy(&BlkBuf[BlkOffset], &RcvUSB.buf[2], RcvUSB.buf[1]);
    BlkOffset += RcvUSB.buf[1];
  }
  
  return 0;
}

/*
** 功能：控制命令
** 输入：
** 输出：
*/
uint8_t FunControl(void)
{
  uint8_t err_code = 0;
  
  switch(RcvUSB.buf[1])
  {
    case 0x01: // 获取版本号
      memset(SndUSB.buf, 0x00, sizeof(SndUSB.buf));
      /* 方式1
      for(cnt=0; '\0'!=*(softVersion+cnt); cnt++)
      {
        USB_SendBuf[2+cnt] = *(softVersion+cnt);
      }*/
      memcpy(&SndUSB.buf[2], SOFT_VERSION, sizeof(SOFT_VERSION));
      break;
    default:
      err_code = 0xFF;
      break;
  }
  
  // 设备状态应答
  SndUSB.hasData = TRUE_t;
  SndUSB.buf[0] = RcvUSB.buf[0];
  SndUSB.buf[1] = err_code; // 错误码
  
  return 0;
}

const uint8_t auchCRCHi[] =  // 高位字节的CRC值
{
  0x00,  0xC1,  0x81,  0x40,  0x01,  0xC0,  0x80,  0x41,  0x01,  0xC0,  0x80, 0x41,
  0x00, 0xC1, 0x81,
  0x40,  0x01,  0xC0,  0x80,  0x41,  0x00,  0xC1,  0x81,  0x40,  0x00,  0xC1, 0x81,
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  0x00, 0xC1, 0x81,
  0x40
};

const uint8_t auchCRCLo[] = // 低位字节的CRC值
{
  0x00,  0xC0,  0xC1,  0x01,  0xC3,  0x03,  0x02,  0xC2,  0xC6,  0x06,  0x07, 0xC7,
  0x05, 0xC5, 0xC4,
  0x04,  0xCC,  0x0C,  0x0D,  0xCD,  0x0F,  0xCF,  0xCE,  0x0E,  0x0A,  0xCA, 0xCB,
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  0x41, 0x81, 0x80,
  0x40
};

/*
** 功能：CRC-16校验码计算
** 输入：*buf[数据buffer]  size[buffer长度]
** 输出：计算得出的校验码
*/
static uint16_t CRC16(uint8_t *buf, uint32_t size)
{
  uint32_t i = 0;
  uint8_t uchCRCHi = 0xFF;
  uint8_t uchCRCLo = 0xFF;
  uint8_t uIndex = 0x00;

  for(i = 0; i < size; i++)
  {
      uIndex = uchCRCLo ^ (uint8_t)buf[i];
      uchCRCLo = uchCRCHi ^ auchCRCHi[uIndex];
      uchCRCHi = auchCRCLo[uIndex];
  }

  return (uchCRCHi << 8 | uchCRCLo);
}
